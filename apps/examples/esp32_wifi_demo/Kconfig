## apps/examples/esp32_wifi_demo/Kconfig
```kconfig
#
# For a description of the syntax of this configuration file,
# see kconfig-language at https://www.kernel.org/doc/Documentation/kbuild/kconfig-language.txt
#

config EXAMPLES_ESP32WIFIDEMO
	bool "ESP32 Wi-Fi test"
	default n
	---help---

config USER_ENTRYPOINT
	string
	default "esp32_tash_main" if ENTRY_ESP32WIFIDEMO
```
